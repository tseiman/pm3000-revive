## components/dropbear/configs/buildroot-pm3000_defconfig
```kconfig
BR2_powerpc=y
BR2_powerpc_e300c3=y
BR2_POWERPC_SOFT_FLOAT=y
BR2_STATIC_LIBS=y
BR2_TOOLCHAIN_BUILDROOT_MUSL=y
BR2_KERNEL_HEADERS_VERSION=y
BR2_DEFAULT_KERNEL_VERSION="2.6.23"
BR2_PACKAGE_HOST_LINUX_HEADERS_CUSTOM_REALLY_OLD=y
BR2_BINUTILS_VERSION_2_44_X=y
BR2_GCC_VERSION_14_X=y
BR2_TOOLCHAIN_BUILDROOT_USE_SSP=y
BR2_TARGET_GENERIC_GETTY=n
BR2_TARGET_GENERIC_REMOUNT_ROOTFS_RW=n
BR2_ENABLE_LOCALE=n
BR2_PACKAGE_BUSYBOX=n
BR2_TARGET_ROOTFS_TAR=n
BR2_GLOBAL_PATCH_DIR="../patches"
```
